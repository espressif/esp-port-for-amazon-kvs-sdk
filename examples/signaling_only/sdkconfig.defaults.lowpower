## examples/simple_video_server/main/Kconfig.projbuild
```kconfig
menu "Simple Video Server"

choice CAPTURE_BACKEND
    prompt "Video capture backend"
    default CAPTURE_DIRECT_V4L2
    help
        Select capture backend: direct V4L2 (esp-video style) or media_stream.

config CAPTURE_DIRECT_V4L2
    bool "Direct V4L2"
    help
        Use example_video_init + V4L2 + example_encoder (same as esp-video simple_video_server).
        Recommended for verifying camera works before media_stream.

config CAPTURE_MEDIA_STREAM
    bool "Media stream"
    help
        Use media_stream component (MJPEGFrameGrabber). Camera init via esp_video_if.

endchoice

config CAPTURE_MEDIA_STREAM_WIDTH
    int "Media stream frame width"
    default 640
    depends on CAPTURE_MEDIA_STREAM
    help
        Frame width for media_stream backend.

config CAPTURE_MEDIA_STREAM_HEIGHT
    int "Media stream frame height"
    default 480
    depends on CAPTURE_MEDIA_STREAM
    help
        Frame height for media_stream backend.

config CAPTURE_MEDIA_STREAM_QUALITY
    int "Media stream JPEG quality"
    default 80
    range 1 100
    depends on CAPTURE_MEDIA_STREAM
    help
        JPEG quality (1-100) for media_stream backend.

endmenu
```

## examples/streaming_only/main/Kconfig.projbuild
```kconfig
menu "Example Configuration"

    config EXAMPLE_ENABLE_POWER_SAVE
        bool "Enable automatic deep sleep power save"
        default n
        # default n if SLAVE_CHIPSET_ESP32C5
        # default y if IDF_TARGET_ESP32P4 && !SLAVE_CHIPSET_ESP32C5
        help
            Enable automatic deep sleep timer management based on WebRTC peer connections.
            When enabled, the device will automatically enter deep sleep after all peer
            connections are closed and no activity is detected for a configured timeout.

            This feature is only available for ESP32-P4 target.

    menu "Co-processor (C6) recovery"

        config STREAMING_HEARTBEAT_INTERVAL_SEC
            int "Co-processor heartbeat interval (seconds)"
            default 5
            help
                How often the C6 co-processor emits an ESP-Hosted heartbeat.

        config STREAMING_ENABLE_HEARTBEAT_MONITOR
            bool "Detect co-processor hang via heartbeat timeout"
            default y
            help
                Trip recovery if no heartbeat arrives within the timeout below
                (catches a hung C6; a C6 reboot is caught by its re-INIT event).

        config STREAMING_HEARTBEAT_TIMEOUT_SEC
            int "Heartbeat timeout (seconds)"
            depends on STREAMING_ENABLE_HEARTBEAT_MONITOR
            range 2 600
            default 15
            help
                Must be larger than STREAMING_HEARTBEAT_INTERVAL_SEC - a timeout at
                or below the interval trips recovery on a healthy co-processor and
                loops forever. hosted_recovery.c fails the build if it is not.

        choice STREAMING_HOSTED_RECOVERY_METHOD
            bool "Action when the C6 reboots or hangs"
            default STREAMING_DO_HOSTED_RECOVERY
            help
                On p4x/p4_eye the C6 cannot reset the P4, so a C6 self-reboot
                orphans the P4<->C6 SDIO link. Pick how the P4 recovers.

            config STREAMING_DO_HOSTED_RECOVERY
                bool "Re-establish the ESP-Hosted transport (recommended)"

            config STREAMING_DO_HOST_RESET
                bool "Reboot the P4 host"

            config STREAMING_DO_NOTHING
                bool "Do nothing"
        endchoice

    endmenu

endmenu
```

## examples/webrtc_person_detect/main/Kconfig.projbuild
```kconfig
menu "Person Detection Example"

    config PERSON_DETECT_VIDEO_WIDTH
        int "Capture width"
        default 1280
        help
            One profile serves the whole example - the encoder and WebRTC both
            describe this. The preview and the detector scale from it themselves
            and are unaffected.

            This is a REQUEST, and on the P4 CSI path the sensor has the last word: the
            video device is bound to the sensor's compiled default format and rejects
            VIDIOC_S_FMT for any other size, so changing this alone silently keeps the
            old resolution (esp_video_if falls back and logs a warning). Change the
            matching CONFIG_CAMERA_<sensor>_MIPI_DEFAULT_FMT_* choice with it.

    config PERSON_DETECT_VIDEO_HEIGHT
        int "Capture height"
        default 720

    config PERSON_DETECT_VIDEO_FPS
        int "Capture frame rate"
        range 1 60
        default 30

    config PERSON_DETECT_VIDEO_BITRATE
        int "Requested bitrate (kbps)"
        range 100 8000
        default 1000
        help
            Carried in video_capture_config_t.

            It does NOT set the encoder's bitrate ceiling, despite how it reads: on the
            P4 CSI path esp32p4_frame_grabber.c derives that from the resolution instead
            (LINK_BASE_BITRATE_BPS * height / 720, so 1 Mbps at 720p and 1.5 Mbps at
            1080p) and overwrites whatever arrived here. That ceiling is the top of the
            rate-control ladder; the floor is VIDEO_RATE_CTRL_MIN_MBPS_PER_PX. Keep this
            value near the derived one so the two do not tell different stories.

    config PERSON_DETECT_FPS
        int "Inference rate (frames per second)"
        range 1 30
        default 5
        help
            How many camera frames per second are handed to the model. The rest
            are dropped by the bus before they are ever queued, which is much
            cheaper than receiving 30 and discarding 25.

            pedestrian_detect takes roughly 60 ms per frame on the P4, so the
            model itself tops out near 16 fps. 5 is a sensible default: it keeps
            detection responsive while leaving the CPU to the encoder and the
            preview.

            This costs nothing in camera buffers - the inference sink is a
            converted sink, so the PPA hands it a small private frame and the
            camera buffer goes straight back.

    config PERSON_DETECT_PREVIEW_FPS
        int "LCD preview rate (frames per second)"
        range 1 30
        default 5
        help
            How often the LCD preview is refreshed. Independent of the inference
            rate, which is the point: the preview stays smooth while detection
            runs slowly behind it.

            Because the two are asynchronous, the boxes on screen belong to an
            earlier frame than the picture under them - by roughly one inference
            period. That is expected.

    config PERSON_DETECT_SCORE_THRESHOLD
        int "Detection score threshold (percent)"
        range 1 99
        default 70
        help
            Minimum confidence for a detection to be reported, as a percentage.
            The model's own default is 70.

            Lower catches more distant or partly occluded people at the cost of
            false positives; higher is stricter.

    config PERSON_DETECT_ENABLE_AT_BOOT
        bool "Start inference at boot"
        default y
        help
            When set, the inference sink starts enabled. When clear it is
            registered but idle until "detect on" is typed at the console, which
            is useful for measuring what inference actually costs the rest of the
            pipeline.

            The preview is unaffected either way.

endmenu
```
