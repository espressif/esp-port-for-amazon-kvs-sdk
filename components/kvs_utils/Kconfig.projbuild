## components/signaling/kvs_signaling/Kconfig.projbuild
```kconfig
menu "KVS Signaling Configuration"

    config USE_ESP_WEBSOCKET_CLIENT
        bool "Use esp_websocket_client instead of libwebsockets"
        default n if IDF_TARGET_LINUX
        default y
        help
            Kinesis Video Stream SDK uses libwebsockets for the signaling API requests.
            By using esp_websocket_client, you get better control over memory usage as the complete signaling part is re-implemented with ESP-IDF constraints in mind

    config PREFER_DYNAMIC_ALLOCS
        bool "Prefer dynamic memory allocations"
        default y
        help
            When enabled, use dynamic memory allocation for signaling payloads and URLs.
            This can reduce static memory usage but may increase heap fragmentation.
            Enable this option on platforms with limited memory to avoid large static allocations.

    config KVS_SIGNALING_WSS_PING_INTERVAL_SEC
        int "WebSocket keep-alive ping interval (seconds)"
        range 5 300
        default 10
        help
            Keep-alive cadence on the signaling WebSocket. Each ping is a radio
            transmit, so a longer interval costs less power.

            If the interval is too long, an idle NAT or AWS can drop the
            channel. The failure appears later, when a viewer offer does not
            arrive.

            The value also sets secs_since_valid_ping in the libwebsockets
            build, so both paths use one cadence.

    config KVS_ICE_CONFIG_PREFETCH
        bool "Refresh the ICE server config before a session needs it"
        depends on USE_ESP_WEBSOCKET_CLIENT
        default y
        help
            While signaling is connected, refresh the TURN server config as soon as it is due.
            A new viewer session then starts with a valid config.
            Without this option, the first session after the config expires starts the refresh.
            The refresh costs one GetIceServerConfig call about every 4.5 minutes while connected.
            Disable it on devices that need to stay idle to save power.

    config KVS_ICE_REFRESH_TASK_STACK_SIZE
        int "ICE refresh task stack size (bytes)"
        depends on USE_ESP_WEBSOCKET_CLIENT
        default 16384 if SPIRAM
        default 8192
        help
            Stack of the task that refreshes the ICE server config. The refresh makes one
            HTTPS call. The stack comes from PSRAM when there is PSRAM, and from internal RAM
            otherwise, and it is held for as long as the device runs.
endmenu
```
