## components/app_webrtc/Kconfig.projbuild
```kconfig
menu "App WebRTC Configuration"

    config KVS_MAX_CONCURRENT_STREAMS
        int "Maximum concurrent streams"
        default 2
        range 1 5
        help
            Maximum number of concurrent WebRTC streams. (Tested for MAX 3 with 16 MAX sockets setting)
            Please increase max sockets from 10 to larger number if you wish to use higher simultaneous connections.
            Note that more simultaneous connection means higher memory usage

    config APP_WEBRTC_MAX_EVENT_CALLBACKS
        int "Maximum event callback handlers"
        default 5
        range 1 16
        help
            Maximum number of event callback handlers that can be registered.
            Each handler receives all WebRTC events. Increase if you need more handlers.

    config APP_WEBRTC_TASK_STACK_SIZE
        int "WebRTC run task stack size (bytes)"
        default 16384
        range 8192 65536
        help
            Stack size for the main WebRTC run task. Use 16384 when using
            esp_websocket_client based signaling. Increase to 32K when using
            libwebsockets based signaling which requires more stack.

endmenu
```

## components/signaling/apprtc_signaling/Kconfig
```kconfig
menu "AppRTC signaling"

    config APPRTC_SERVER_URL
        string "AppRTC server URL"
        default "https://webrtc.espressif.com"
        help
            Room server that answers POST /join/<room>. Point this at a local
            AppRTC deployment to sign a device in without any internet service.

    config APPRTC_ICE_SERVER_URL
        string "AppRTC ICE server config URL"
        default "https://webrtc.espressif.com/iceconfig"
        help
            Endpoint that returns the STUN and TURN servers to offer to ICE.
            Point this at a local coturn deployment together with
            APPRTC_SERVER_URL to keep a session entirely on the local network.

    config APPRTC_USE_FIXED_ROOM
        bool "Use a fixed room ID"
        default n
        help
            Join the same room on every boot instead of generating one. A test
            needs this: the viewer has to know which room to join.

    config APPRTC_ROOM_ID
        string "Fixed AppRTC room ID"
        default "esp32test"
        depends on APPRTC_USE_FIXED_ROOM
        help
            Room to join when APPRTC_USE_FIXED_ROOM is set.

endmenu
```

## components/signaling/kvs_signaling/Kconfig.projbuild
```kconfig
menu "KVS Signaling Configuration"

    config USE_ESP_WEBSOCKET_CLIENT
        bool "Use esp_websocket_client instead of libwebsockets"
        default n if IDF_TARGET_LINUX
        default y
        help
            Kinesis Video Stream SDK uses libwebsockets for the signaling API requests.
            By using esp_websocket_client, you get better control over memory usage as the complete signaling part is re-implemented with ESP-IDF constraints in mind

    config PREFER_DYNAMIC_ALLOCS
        bool "Prefer dynamic memory allocations"
        default y
        help
            When enabled, use dynamic memory allocation for signaling payloads and URLs.
            This can reduce static memory usage but may increase heap fragmentation.
            Enable this option on platforms with limited memory to avoid large static allocations.

    config KVS_SIGNALING_WSS_PING_INTERVAL_SEC
        int "WebSocket keep-alive ping interval (seconds)"
        range 5 300
        default 10
        help
            Keep-alive cadence on the signaling WebSocket. Each ping is a radio
            transmit, so a longer interval costs less power.

            If the interval is too long, an idle NAT or AWS can drop the
            channel. The failure appears later, when a viewer offer does not
            arrive.

            The value also sets secs_since_valid_ping in the libwebsockets
            build, so both paths use one cadence.
endmenu
```

## components/slave_flasher/Kconfig.projbuild
```kconfig
menu "Slave Flasher Configuration"

    config SLAVE_FLASHER_ENABLE
        bool "Enable slave flashing via host"
        default n
        help
            Enable the slave flasher component to flash firmware to a slave ESP32
            device via UART. When enabled, the host device can flash bootloader,
            partition table, and application binaries to the slave device.

    choice SLAVE_FLASHER_IMAGE_SOURCE
        prompt "Slave image source"
        default SLAVE_FLASHER_IMAGE_SPIFFS
        depends on SLAVE_FLASHER_ENABLE
        help
            Select where flash_slave() reads bootloader.bin, partition-table.bin
            and app.bin from.

        config SLAVE_FLASHER_IMAGE_SPIFFS
            bool "SPIFFS partition 'slave'"
            help
                The component packs the images into a SPIFFS partition with the
                label 'slave'. An app OTA does not update this partition.

        config SLAVE_FLASHER_IMAGE_EMBEDDED
            bool "Embedded in the app binary"
            help
                Embed the images in the app binary as rodata. Each app OTA
                then brings its own slave image. The 'slave' partition and
                the spiffs component are not necessary.
    endchoice

    config SLAVE_FLASHER_IMAGE_DIR
        string "Directory with the slave images"
        default "target-firmware"
        depends on SLAVE_FLASHER_ENABLE
        help
            Directory that holds bootloader.bin, partition-table.bin and app.bin.
            A relative path starts at the project directory.

    config SLAVE_PARTITION_TABLE_ADDRESS
        hex "Partition Table Address"
        default 0xC000
        depends on SLAVE_FLASHER_ENABLE
        help
            Flash address where the partition table will be written.
            Default is 0xC000 (49152 decimal).

    config SLAVE_APPLICATION_ADDRESS
        hex "Application Address"
        default 0x20000
        depends on SLAVE_FLASHER_ENABLE
        help
            Flash address where the application binary will be written.
            Default is 0x20000 (131072 decimal).

    config SLAVE_UART_RX_PIN
        int "UART RX Pin"
        default 22
        depends on SLAVE_FLASHER_ENABLE || SLAVE_CONSOLE_ENABLE
        help
            GPIO pin number for UART RX.
            Default is 22.

    config SLAVE_UART_TX_PIN
        int "UART TX Pin"
        default 21
        depends on SLAVE_FLASHER_ENABLE || SLAVE_CONSOLE_ENABLE
        help
            GPIO pin number for UART TX.
            Default is 21.

    config SLAVE_GPIO0_TRIGGER_PIN
        int "GPIO0 Trigger Pin"
        default 20
        depends on SLAVE_FLASHER_ENABLE
        help
            GPIO pin number for GPIO0 trigger.
            Default is 20.

    config SLAVE_CONSOLE_ENABLE
        bool "Forward the co-processor console to the host"
        default y if SLAVE_FLASHER_ENABLE
        default n
        help
            Pipe the co-processor's UART output to the host log behind a "[SLAVE]"
            prefix, and register the write_slave command. Independent of
            SLAVE_FLASHER_ENABLE, so a co-processor programmed another way keeps
            its console. TX is driven only while write_slave sends, so a
            co-processor with its own USB-UART bridge on the same lines is safe.

endmenu
```

## examples/common_components/app_common/Kconfig.projbuild
```kconfig
menu "App Common Configs (Wi-Fi, SD-Card, Camera)"
    config APP_COMMON_USE_SPIFFS
        bool "Read certs from SPIFFS"
        default y
        help
            If enabled, default SPIFFS will be considered and flashed
            Disable this option to plug your own file_system partition

    config ESP_WIFI_SSID
        string "WiFi SSID"
        default "myssid"
        help
            SSID (network name) for the example to connect to.

    config ESP_WIFI_PASSWORD
        string "WiFi Password"
        default "mypassword"
        help
            WiFi password (WPA or WPA2) for the example to use.

    config ESP_MAXIMUM_RETRY
        int "Maximum retry"
        default 5
        help
            Set the Maximum retry to avoid station reconnecting to the AP unlimited when the AP is really inexistent.

    config APP_NETWORK_PROV_BLE
        bool "Enable BLE provisioning for WiFi credentials"
        default n
        depends on BT_ENABLED && BT_NIMBLE_ENABLED
        help
            Enable BLE-based WiFi provisioning using the network_provisioning component.
            When enabled, if the device has no stored WiFi credentials, it will start
            a BLE provisioning service. Use the "ESP BLE Provisioning" phone app to
            provide WiFi credentials.

    config APP_NETWORK_PROV_POP
        string "Proof of Possession (PoP) string"
        default "abcd1234"
        depends on APP_NETWORK_PROV_BLE
        help
            Proof of possession string used during BLE provisioning for security.
            The same string must be entered in the provisioning phone app.

    config EXAMPLE_FORMAT_IF_MOUNT_FAILED
        bool "Format the card if mount failed"
        default n
        help
            If this config item is set, format_if_mount_failed will be set to true and the card will be formatted if
            the mount has failed.

    choice EXAMPLE_SDMMC_BUS_WIDTH
        prompt "SD/MMC bus width"
        default EXAMPLE_SDMMC_BUS_WIDTH_1
        help
            Select the bus width of SD or MMC interface.
            Note that even if 1 line mode is used, D3 pin of the SD card must have a pull-up resistor connected.
            Otherwise the card may enter SPI mode, the only way to recover from which is to cycle power to the card.

        config EXAMPLE_SDMMC_BUS_WIDTH_4
            bool "4 lines (D0 - D3)"

        config EXAMPLE_SDMMC_BUS_WIDTH_1
            bool "1 line (D0)"
    endchoice

    menu "SD card pin configuration"
        # Pins are wired GPIO-IO-MUX on ESP32 and via the GPIO matrix
        # elsewhere. Targets without SDMMC (c5/c6) or without a defined
        # board pinout fall back to -1 ("unset") so kconfig stops
        # warning about missing defaults. app_storage.c treats -1 as
        # "SD card disabled".

        config EXAMPLE_PIN_CMD
            int "CMD GPIO number"
            default 15 if IDF_TARGET_ESP32
            default 35 if IDF_TARGET_ESP32S3
            default 44 if IDF_TARGET_ESP32P4
            default -1

        config EXAMPLE_PIN_CLK
            int "CLK GPIO number"
            default 14 if IDF_TARGET_ESP32
            default 36 if IDF_TARGET_ESP32S3
            default 43 if IDF_TARGET_ESP32P4
            default -1

        config EXAMPLE_PIN_D0
            int "D0 GPIO number"
            default 2  if IDF_TARGET_ESP32
            default 37 if IDF_TARGET_ESP32S3
            default 39 if IDF_TARGET_ESP32P4
            default -1

        if EXAMPLE_SDMMC_BUS_WIDTH_4

            config EXAMPLE_PIN_D1
                int "D1 GPIO number"
                default 4  if IDF_TARGET_ESP32
                default 38 if IDF_TARGET_ESP32S3
                default 40 if IDF_TARGET_ESP32P4
                default -1

            config EXAMPLE_PIN_D2
                int "D2 GPIO number"
                default 12 if IDF_TARGET_ESP32
                default 33 if IDF_TARGET_ESP32S3
                default 41 if IDF_TARGET_ESP32P4
                default -1

            config EXAMPLE_PIN_D3
                int "D3 GPIO number"
                default 13 if IDF_TARGET_ESP32
                default 34 if IDF_TARGET_ESP32S3
                default 42 if IDF_TARGET_ESP32P4
                default -1

        endif  # EXAMPLE_SDMMC_BUS_WIDTH_4

    endmenu  # SD card pin configuration
endmenu

menu "AWS Security Credentials "

    config AWS_KVS_CHANNEL_NAME
        string "KVS Channel Name"
        default "ESP32Channel"
        help
            The name of the signaling channel to use for WebRTC communication.

    config AWS_DEFAULT_REGION
        string "AWS Region"
        default "us-east-1"
        help
            AWS Region for KVS service.

    config IOT_CORE_ENABLE_CREDENTIALS
        bool "Enable AWS IoT Core credentials for authentication"
        default y
        help
            Enable this option to use AWS IoT Core credentials for authentication.
            When enabled, the application will use the AWS IoT Core credentials provider
            to obtain temporary credentials for accessing AWS services.
            If disabled, application should set access key instead

    config AWS_IOT_CORE_CREDENTIAL_ENDPOINT
        string "AWS IoT Core Credential Endpoint"
        default "credential-endpoint.credentials.iot.us-east-1.amazonaws.com"
        depends on IOT_CORE_ENABLE_CREDENTIALS
        help
            AWS IoT Core credential endpoint to use for credential provider. This is the endpoint used for the AWS IoT credential provider.

    config AWS_IOT_CORE_CERT
        string "AWS IoT Core Certificate"
        default "/spiffs/certs/iot-certificate.pem.crt"
        depends on IOT_CORE_ENABLE_CREDENTIALS
        help
            Path to the AWS IoT Core certificate file. This certificate is used for authenticating with AWS IoT Core.

    config AWS_IOT_CORE_PRIVATE_KEY
        string "AWS IoT Core Private Key"
        default "/spiffs/certs/iot-private.pem.key"
        depends on IOT_CORE_ENABLE_CREDENTIALS
        help
            Path to the AWS IoT Core private key file. This key is used for authenticating with AWS IoT Core.

    config AWS_IOT_CORE_ROLE_ALIAS
        string "AWS IoT Core Role Alias"
        default "KVS-WebRTC-Role-Alias"
        depends on IOT_CORE_ENABLE_CREDENTIALS
        help
            AWS IoT Core role alias to use for credential provider. This role alias is used to assume a role with the necessary permissions.

    config AWS_IOT_CORE_THING_NAME
        string "AWS IoT Core Thing Name"
        default "ESP32-WebRTC-Camera"
        depends on IOT_CORE_ENABLE_CREDENTIALS
        help
            AWS IoT Core thing name. This identifies your device in AWS IoT Core.

    config AWS_ACCESS_KEY_ID
        string "AWS Access Key ID"
        default ""
        depends on !IOT_CORE_ENABLE_CREDENTIALS
        help
            AWS Access Key ID for KVS access. Used when not using IoT Core credentials.

    config AWS_SECRET_ACCESS_KEY
        string "AWS Secret Access Key"
        default ""
        depends on !IOT_CORE_ENABLE_CREDENTIALS
        help
            AWS Secret Access Key for KVS access. Used when not using IoT Core credentials.

    config AWS_SESSION_TOKEN
        string "AWS Session Token"
        default ""
        depends on !IOT_CORE_ENABLE_CREDENTIALS
        help
            AWS session token. Keep this empty if not needed

endmenu
```

## examples/esp_camera/main/Kconfig.projbuild
```kconfig
menu "ESP WebRTC Camera Configuration"
    config APPRTC_ROLE_TYPE
        int "WebRTC role type"
        default 1
        range 0 1
        help
            Role reported by get-role and in the logs (0: MASTER, 1: VIEWER).
            With AppRTC it does not change the session: the device sends the
            offer when it is first in the room and answers when it joins a room
            a browser is already in.

    config APPRTC_AUTO_CONNECT
        bool "Auto-connect to signaling server on startup"
        default y
        help
            Selects the boot log banner only: the device connects to the signaling
            server on startup either way.

    config APPRTC_LOG_VERBOSE
        bool "Enable verbose AppRTC logging"
        default n
        help
            Enable verbose logging for AppRTC signaling.
endmenu
```
