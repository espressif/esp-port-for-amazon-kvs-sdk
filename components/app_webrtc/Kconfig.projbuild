## examples/esp_camera/sdkconfig.defaults.esp32c6
```kconfig
# Slave
CONFIG_SLAVE_LWIP_ENABLED=y

# Disable BT coprocessor forwarding (not needed for camera use case)
CONFIG_ESP_HOSTED_COPROCESSOR_BT_ENABLED=n
CONFIG_LWIP_TCP_LOCAL_PORT_RANGE_START=61440
CONFIG_LWIP_TCP_LOCAL_PORT_RANGE_END=65535
CONFIG_LWIP_UDP_LOCAL_PORT_RANGE_START=61440
CONFIG_LWIP_UDP_LOCAL_PORT_RANGE_END=65535
CONFIG_ESP_DEFAULT_LWIP_BOTH=y

CONFIG_FREERTOS_USE_TRACE_FACILITY=y
CONFIG_FREERTOS_USE_STATS_FORMATTING_FUNCTIONS=y
# CONFIG_FREERTOS_USE_LIST_DATA_INTEGRITY_CHECK_BYTES is not set
CONFIG_FREERTOS_VTASKLIST_INCLUDE_COREID=y
CONFIG_FREERTOS_GENERATE_RUN_TIME_STATS=y

# OS
CONFIG_FREERTOS_HZ=1000

CONFIG_FREERTOS_PLACE_FUNCTIONS_INTO_FLASH=y
CONFIG_ESP_WIFI_EXTRA_IRAM_OPT=n
CONFIG_LWIP_TCPIP_RECVMBOX_SIZE=24
CONFIG_LWIP_TCP_OVERSIZE_QUARTER_MSS=y
CONFIG_LWIP_TCP_ACCEPTMBOX_SIZE=4

# DANGER: Do not touch me!!!
# CONFIG_HOSTED_ON_LOW_MEM=y
CONFIG_ESP_USE_MEMPOOL=y
CONFIG_ESP_PKT_STATS=y
```

## examples/signaling_only/sdkconfig.defaults
```kconfig
# Signaling only module defaults to ESP32C6
CONFIG_IDF_TARGET="esp32c6"
CONFIG_IDF_TARGET_ESP32C6=y

# Define component-specific flag
CONFIG_ENABLE_SIGNALLING_ONLY=y

#
# Serial flasher config
#
CONFIG_ESPTOOLPY_FLASHMODE_QIO=y
CONFIG_ESPTOOLPY_FLASHFREQ_80M=y
CONFIG_ESPTOOLPY_FLASHSIZE_4MB=y

#
# Partition Table
#
CONFIG_PARTITION_TABLE_CUSTOM=y
CONFIG_PARTITION_TABLE_CUSTOM_FILENAME="partitions.csv"
CONFIG_PARTITION_TABLE_FILENAME="partitions.csv"
CONFIG_PARTITION_TABLE_OFFSET=0x8000

#
# SNTP
#
CONFIG_LWIP_SNTP_MAX_SERVERS=3

CONFIG_LWIP_DHCP_MAX_NTP_SERVERS=1

# AWS IoT Core support
CONFIG_IOT_CORE_ENABLE_CREDENTIALS=y


# Note: ESP32-C6 does not have SPIRAM support
# SPIRAM configs are only used when building for chips that support it (e.g., ESP32-C5)

#
# Wi-Fi
#
CONFIG_ESP_WIFI_STATIC_TX_BUFFER=n
CONFIG_ESP_WIFI_DYNAMIC_TX_BUFFER=y

CONFIG_LOG_DEFAULT_LEVEL=3

CONFIG_MBEDTLS_EXTERNAL_MEM_ALLOC=y

CONFIG_MBEDTLS_SSL_PROTO_DTLS=y
CONFIG_MBEDTLS_SSL_ALPN=y

# fix build issues on idf master
# CONFIG_MBEDTLS_X509_CREATE_C=y
# CONFIG_MBEDTLS_SSL_DTLS_SRTP=y

#
# FreeRTOS
#
CONFIG_FREERTOS_PLACE_FUNCTIONS_INTO_FLASH=y
CONFIG_FREERTOS_PLACE_SNAPSHOT_FUNS_INTO_FLASH=y

#
# ESP Ringbuf
#
CONFIG_RINGBUF_PLACE_FUNCTIONS_INTO_FLASH=y
CONFIG_RINGBUF_PLACE_ISR_FUNCTIONS_INTO_FLASH=y

#
# ESP System Settings
#
CONFIG_ESP_SYSTEM_ALLOW_RTC_FAST_MEM_AS_HEAP=y

#
# PThreads
#
CONFIG_PTHREAD_TASK_STACK_SIZE_DEFAULT=8000
CONFIG_PTHREAD_STACK_MIN=4096

CONFIG_MAIN_TASK_STACK_SIZE=8192
CONFIG_IPC_TASK_STACK_SIZE=1024
CONFIG_TIMER_TASK_STACK_SIZE=3584

CONFIG_MB_SERIAL_TASK_STACK_SIZE=2048
CONFIG_SUPPORT_STATIC_ALLOCATION=y


CONFIG_ESP_SYSTEM_EVENT_TASK_STACK_SIZE=4000

# mbedtls dynamic buffer for memory optimization
CONFIG_MBEDTLS_ASYMMETRIC_CONTENT_LEN=y

CONFIG_MBEDTLS_SSL_VARIABLE_BUFFER_LENGTH=n
CONFIG_MBEDTLS_DYNAMIC_BUFFER=y
CONFIG_MBEDTLS_DYNAMIC_FREE_CONFIG_DATA=y
CONFIG_MBEDTLS_DYNAMIC_FREE_CA_CERT=y
CONFIG_MBEDTLS_DYNAMIC_FREE_PEER_CERT=y

CONFIG_ESP_MAIN_TASK_STACK_SIZE=8192
CONFIG_ESP_SYSTEM_EVENT_TASK_STACK_SIZE=4096

CONFIG_FREERTOS_HZ=1000

CONFIG_LWIP_TCP_SND_BUF_DEFAULT=5760
CONFIG_LWIP_TCP_WND_DEFAULT=5760
CONFIG_LWIP_TCP_RECVMBOX_SIZE=6
CONFIG_LWIP_UDP_RECVMBOX_SIZE=6
CONFIG_LWIP_TCPIP_RECVMBOX_SIZE=64

#
# Websockets
#
CONFIG_WS_BUFFER_SIZE=2048
CONFIG_WS_DYNAMIC_BUFFER=y

# Additional WebRTC configs
CONFIG_ENABLE_DATA_CHANNEL=n

#
# ESP-Hosted - Network coprocessor
#
CONFIG_SLAVE_LWIP_ENABLED=y
CONFIG_ESP_HOSTED_NETWORK_SPLIT_ENABLED=y
CONFIG_ESP_HOSTED_CP_WIFI=y
CONFIG_ESP_HOSTED_CP_BT=n

#
# BLE Provisioning
#
CONFIG_BT_ENABLED=y
CONFIG_BT_NIMBLE_ENABLED=y
CONFIG_APP_NETWORK_PROV_BLE=y

#Disable enterprise support by default
CONFIG_ESP_WIFI_ENTERPRISE_SUPPORT=n

# Disable ESP-Hosted coprocessor app_main (we provide our own)
CONFIG_ESP_HOSTED_COPROCESSOR_APP_MAIN=n

# Create wifi sta in example, instead of internal slave code base
CONFIG_ESP_HOSTED_REUSE_WIFI_STA_DEF_NETIF_INSTANCE=y

# Hosted - Re-use CLI instance
CONFIG_ESP_HOSTED_CLI_NEW_INSTANCE=n
```
